## main/Kconfig.projbuild
```kconfig
menu "App Configuration"

    config APP_MQTT_URI
        string "MQTT URI"
        default "mqtts://example.org:1883"
        help
            The MQTT broker URI to connect to.

    config APP_OTA_URI
        string "OTA URI"
        default "https://example.org:3232"
        help
            The OTA firmware update URL.

endmenu
```

## sdkconfig.defaults
```kconfig
CONFIG_ESPTOOLPY_FLASHSIZE_4MB=y

# CONFIG_PARTITION_TABLE_SINGLE_APP=n
# CONFIG_PARTITION_TABLE_TWO_OTA=y]

CONFIG_PARTITION_TABLE_CUSTOM=y
CONFIG_PARTITION_TABLE_CUSTOM_FILENAME="partitions.csv"
CONFIG_PARTITION_TABLE_CUSTOM_APP_BIN_OFFSET=0x10000


# CONFIG_SPIRAM_CACHE_WORKAROUND=y



# --- from homkit SDK examples
CONFIG_FREERTOS_UNICORE=y
CONFIG_FREERTOS_ASSERT_ON_UNTESTED_FUNCTION=n
CONFIG_FREERTOS_ASSERT_FAIL_ABORT=n
CONFIG_FREERTOS_ASSERT_DISABLE=y

CONFIG_LWIP_MAX_SOCKETS=16
CONFIG_LWIP_SO_REUSE=y
CONFIG_LWIP_MAX_ACTIVE_TCP=12
CONFIG_LWIP_MAX_LISTENING_TCP=12
CONFIG_LWIP_UDP_RECVMBOX_SIZE=10
CONFIG_LWIP_AUTOIP=y
CONFIG_LWIP_AUTOIP_RATE_LIMIT_INTERVAL=60

CONFIG_MBEDTLS_HARDWARE_MPI=y
CONFIG_MBEDTLS_HARDWARE_SHA=n

CONFIG_ENABLE_UNIFIED_PROVISIONING=y

CONFIG_ESP_TASK_WDT=n
CONFIG_ESPTOOLPY_FLASHSIZE_4MB=y
CONFIG_MP_BLOB_SUPPORT=y

# --- end homekit


# Override some defaults so BT stack is enabled
CONFIG_BT_ENABLED=y
CONFIG_BT_BLUEDROID_ENABLED=y

CONFIG_BTDM_CTRL_MODE_BLE_ONLY=y
CONFIG_BTDM_CTRL_MODE_BR_EDR_ONLY=n
# BLE + Classic
CONFIG_BTDM_CTRL_MODE_BTDM=n
```
